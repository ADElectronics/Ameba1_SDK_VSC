# RTL8195AM register map
File version: 1.1
CPU: CM3 r2p0, little endian, MPU, no FPU, vendor SysTick, 4 interrupt priority bits
Registers are 32-bit, read-write, reset 0x0 unless marked. A register's access mark holds for its fields unless they carry their own. Offsets are from the block's base; lines under a group give offsets from that group; [hi:lo] are bit positions; {n}, {i} and the like mark numbered series; 'fields as' and 'values as' point back to an identical list; <NAME> marks a mode.

## Memory map
0x40001000 GPIO size 0x1800 — General-purpose I/Os

## GPIO — General-purpose I/Os
Base 0x40001000
0x00 PORTA_DR — data register
0x04 PORTA_DDR — data direction
0x08 PORTA_CTRL — data source control
0x0C PORTB_DR — data register
0x10 PORTB_DDR — data direction
0x14 PORTB_CTRL — data source control
0x18 PORTC_DR — data register
0x1C PORTC_DDR — data direction
0x20 PORTC_CTRL — data source control
0x30 GPIO_INT_EN — Interrupt enable register
0x34 GPIO_INT_MASK — Interrupt mask
0x38 GPIO_INT_TYPE — Interrupt type(level/edge) register
0x3C GPIO_INT_POLARITY — Interrupt polarity(Active low/high) register
0x40 GPIO_INT_STATUS — Interrupt status
0x44 GPIO_INT_RAWSTATUS — Interrupt status without mask
0x48 GPIO_DEBOUNCE — Interrupt signal debounce
0x4C GPIO_PORTA_EOI — Clear interrupt
0x50 GPIO_EXT_PORTA — GPIO IN read or OUT read back
0x54 GPIO_EXT_PORTB — GPIO IN read or OUT read back
0x58 GPIO_EXT_PORTC — GPIO IN read or OUT read back
0x60 GPIO_INT_SYNC — Is level-sensitive interrupt being sync sith PCLK
